## Kconfig
```kconfig
# Copyright 2026 Roman Kuzmitskii (@damex)
# SPDX-License-Identifier: MIT

if DT_HAS_ZMK_SPLIT_STATE_SYNC_ENABLED

config ZMK_SPLIT_STATE_SYNC_RECONNECT_TIMEOUT_MS
    int "Silence threshold (ms) treated as a peer (re)connect"
    default 10000
    help
      First input from the peer after this much silence triggers a state push.
      Raise if peers can legitimately idle longer than this without being a
      cold-boot, lower for snappier (re)connect detection.

module = ZMK_SPLIT_STATE_SYNC
module-str = zmk_split_state_sync
source "subsys/logging/Kconfig.template.log_config"

endif
```

## dts/bindings/zmk,split-state-sync.yaml
```yaml
# Copyright 2026 Roman Kuzmitskii (@damex)
# SPDX-License-Identifier: MIT

description: |
  Watches a peer's input stream and pushes `bindings` to it on every
  (re)connect, detected as the first input after a long silence. For
  transports without a connect event (e.g. ESB).

compatible: "zmk,split-state-sync"

properties:
  input:
    type: phandle
    required: true
    description: "Peer input-split device to watch for activity."
  source:
    type: int
    required: true
    description: "Peer source id (0 for a single-peripheral central)."
  bindings:
    type: phandle-array
    required: true
    description: "Bindings invoked on the peer on every (re)connect."
```
